## boards/ploopyco/ploopy_adept/ploopy_adept_defconfig
```kconfig
# Copyright (c) 2025 George Norton
# SPDX-License-Identifier: MIT

CONFIG_SYS_CLOCK_HW_CYCLES_PER_SEC=125000000

# Enable reset by default
CONFIG_RESET=y
CONFIG_CLOCK_CONTROL=y

# Code partition needed to target the correct flash range
CONFIG_USE_DT_CODE_PARTITION=y

# Output UF2 by default, native bootloader supports it.
CONFIG_BUILD_OUTPUT_UF2=y

CONFIG_ZMK_USB=y
CONFIG_ZMK_MOUSE=y
# May not work well on MacOS
# CONFIG_ZMK_POINTING_SMOOTH_SCROLLING=y

# zmk-input-processor-acceleration (nuovotaka): unlike the predecessor,
# this Kconfig has no `default $(dt_compat_enabled,...)` so the parent symbol
# has to be enabled explicitly. The choice config below depends on the parent.
CONFIG_ZMK_INPUT_PROCESSOR_ACCELERATION=y
# Pick the multi-speed "Standard" curve so the min-factor/max-factor/
# speed-threshold/speed-max/acceleration-exponent properties in
# ploopy_adept.dts take effect. (Default is SIMPLE which uses a different
# property set.)
CONFIG_INPUT_PROCESSOR_ACCEL_LEVEL_STANDARD=y

# zmk-input-processor-scroll-inertia (mjmjm0101) — auto-enables when the
# &scroll_inertia node is referenced, so no explicit CONFIG needed here.

# Required for persistant settings (mouse wheel DPI and studio keymaps)
CONFIG_MPU_ALLOW_FLASH_WRITE=y
CONFIG_NVS=y
CONFIG_SETTINGS_NVS=y
CONFIG_FLASH=y
CONFIG_FLASH_PAGE_LAYOUT=y
CONFIG_FLASH_MAP=y
CONFIG_SETTINGS=y

CONFIG_ZMK_STUDIO=y
```

## config/west.yml
```yaml
manifest:
  remotes:
    - name: zmkfirmware
      url-base: https://github.com/zmkfirmware
    - name: george-norton
      url-base: https://github.com/george-norton
    - name: badjeff
      url-base: https://github.com/badjeff
    - name: nuovotaka
      url-base: https://github.com/nuovotaka
    - name: mjmjm0101
      url-base: https://github.com/mjmjm0101
    - name: cormoran
      url-base: https://github.com/cormoran
  projects:
    - name: zmk
      remote: zmkfirmware
      revision: main
      import: app/west.yml
    - name: zmk-driver-pmw3360
      remote: george-norton
      revision: v0.3
    - name: zmk-behavior-sensor-attr-cycle
      remote: george-norton
      revision: v0.3
    - name: zmk-driver-rp2040-sleep
      remote: george-norton
      revision: v0.3
    - name: zmk-input-processor-report-rate-limit
      remote: badjeff
      revision: main
    - name: zmk-input-processor-xyz
      remote: badjeff
      revision: main
    # Replaces zmk-pointing-acceleration (oleksandrmaslov). Both modules
    # share the same `pointer_accel` node name and collide when fetched
    # together. Keep only this multi-level fork.
    - name: zmk-pointing-acceleration-alpha
      remote: nuovotaka
      revision: main
    # Scroll inertia: drop-in input processor. No auto-dtsi, so the
    # `&scroll_inertia` node is defined explicitly in ploopy_adept.keymap.
    - name: zmk-input-processor-scroll-inertia
      remote: mjmjm0101
      revision: main
    # Persistence backend for the runtime input processor module.
    # The runtime module itself requires cormoran's patched ZMK
    # (`zmk@cormoran/v0.3+custom-studio-protocol`) for the web-UI RPC.
    - name: zmk-feature-custom-settings
      remote: cormoran
      revision: main
    - name: zmk-module-runtime-input-processor
      remote: cormoran
      revision: main
```

## dts/bindings/input_processors/zmk,input-processor-scroll-smooth.yaml
```yaml
# Copyright (c) 2025 George Norton
# SPDX-License-Identifier: MIT

description: |
  Scroll smoothing input processor for trackball/trackpoint scroll chains.

  Provides three filter stages, applied in order:

    1. DEADZONE  — any absolute delta below `deadzone` is zeroed (removed).
       Prevents tiny sensor jitter from entering the scroll chain.
       Deadzone zero-out does NOT freeze the EMA velocity — internal
       velocity decays toward zero via the alpha coefficient, so a
       micro-pause doesn't cause a velocity overshoot when the user
       resumes scrolling.

    2. EMA LOW-PASS  — exponential moving average on the per-axis delta.
         vel = (delta × alpha + vel × (1000 − alpha)) / 1000
       alpha is in permille: 1000 = passthrough (no smoothing),
       500 = 50% history / 50% new, 100 = very smooth.
       The EMA runs on both axes independently so a fast X flick and
       a slow Y pan each get appropriate smoothing.

    3. ADAPTIVE GAIN  — scale the smoothed output by a velocity-dependent
       factor.  The gain transitions linearly between gain-min and
       gain-max as |vel| rises from gain-threshold to 2× gain-threshold.
         |vel| ≤ threshold    → gain = gain-min
         threshold < |vel| < 2×threshold  → linear interpolation
         |vel| ≥ 2×threshold  → gain = gain-max
       This gives precise low-speed control (gain-min < 1000 slows the
       cursor) and fast high-speed flicking (gain-max > 1000 boosts).

  Recommended placement in the scroller chain:

      zip_xy_transform (orientation)
      zip_xy_to_scroll_mapper
      scroll_smooth: scroll_smooth      ← THIS PROCESSOR
      scroll_inertia: scroll_inertia     ← downstream kinetic scroll

  The EMA here acts as a pre-filter for scroll_inertia's internal
  velocity tracking, smoothing out sensor jitter so the arming
  heuristics (deceleration detection, stop detection) trigger more
  consistently.

compatible: "zmk,input-processor-scroll-smooth"

include: ip_zero_param.yaml

properties:
  deadzone:
    type: int
    default: 0
    description: |
      Minimum absolute delta to pass through.  Values ≤ deadzone in
      magnitude are zeroed.  0 = disabled.

  alpha:
    type: int
    default: 500
    description: |
      EMA coefficient (permille).  1000 = passthrough, 0 = hold only
      (no new input accepted — useful for testing, not recommended
      for actual use).  Typical range [200 .. 800].
        PMW3360 at 900 CPI / 125 Hz:  alpha=300..500 recommended.

  gain-min:
    type: int
    default: 800
    description: |
      Minimum adaptive gain (permille) at or below gain-threshold.
      < 1000 = slow precise scrolls, > 1000 = fast but jittery.

  gain-max:
    type: int
    default: 1500
    description: |
      Maximum adaptive gain (permille) at or above 2× gain-threshold.

  gain-threshold:
    type: int
    default: 500
    description: |
      |vel| threshold where gain-min applies.  At twice this value
      gain-max is reached.  Units are scroll deltas per event
      (same as REL_WHEEL / REL_HWHEEL deltas), scaled by the EMA
      which operates on the same delta range.
```

## src/Kconfig
```kconfig
# Kconfig for built-in input processors

config ZMK_INPUT_PROCESSOR_SCROLL_SMOOTH
    bool "Scroll Smoothing Input Processor (EMA + deadzone + adaptive gain)"
    default y
    depends on DT_HAS_ZMK_INPUT_PROCESSOR_SCROLL_SMOOTH_ENABLED
    select ZMK_POINTING
    help
      Pre-filter for scroll smoothing.  Sits between zip_xy_to_scroll_mapper
      and scroll_inertia.  Applies:
        1) Deadzone truncation  — zero sub-threshold deltas,
        2) EMA low-pass filter  — α = 0..1000 permille,
        3) Adaptive gain        — scale output by velocity.

      Without this filter, scroll_inertia's internal EMA receives raw
      per-event deltas directly from the scroll mapper, which include
      sensor jitter that can make the arming heuristics unreliable
      (false coasts on micro-flicks or missed coasts on fast ones).

      Parameters are settable via Devicetree on the scroll_smooth node.
```
